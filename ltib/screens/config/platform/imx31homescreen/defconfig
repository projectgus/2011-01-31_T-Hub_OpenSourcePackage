## pkgs/linux-2.6.19.2/arch/arm/mach-mx27/Kconfig
```kconfig
menu "MX27 Options"
	depends on ARCH_MX27

config MACH_MX27ADS
	bool "Support MX27ADS platforms"
	default y
	help
	  Include support for MX27ADS platform. This includes specific
	  configurations for the board and its peripherals.

config ISP1504_MXC
	tristate "ISP1504 transceiver support"
	select ISP1504_MXC_OTG if USB_GADGET && USB_EHCI_HCD && USB_OTG
	help
	  Support for the ISP1504 USB transceiver on MXC platforms.

config ISP1504_MXC_OTG
	tristate
	help
	  Support for USB OTG using the ISP1504 transceiver on MXC platforms.

config ISP1301_MXC
	bool
	select I2C_MXC

menu "Device options"

config I2C_MXC_SELECT1
	bool "Enable I2C1 module"
	default y
	depends on I2C_MXC
	help
	  Enable MX31 I2C1 module.

config I2C_MXC_SELECT2
	bool "Enable I2C2 module"
	default n
	depends on I2C_MXC
	help
	  Enable MX31 I2C2 module.

endmenu

endmenu
```

## pkgs/linux-2.6.19.2/arch/arm/mach-mx3/Kconfig
```kconfig
menu "MX3 Options"
	depends on ARCH_MX3

choice
	prompt "Target Machine"
	default MACH_MX31ADS
config MACH_MX31ADS
	bool "Support MX31ADS platforms"
	help
	  Include support for MX31ADS platform. This includes specific
	  configurations for the board and its peripherals.
config MACH_MX31LSV0
	bool "Support MX31 LiveScreen V0" 
	help 
	  Include support for MX31 LiveScreenV0.This
	  includes specific configurations for the board and its peripherals.

config MACH_MX31HSV1
	bool "Support MX31 HomeScreen V1" 
	help 
	  Include support for MX31 HomeScreen V0 (URD30).This
	  includes specific configurations for the board and its peripherals.

endchoice

config MX3_DOZE_DURING_IDLE
	bool "Enter Doze mode during idle"
	help
	  Turning on this option will put the CPU into Doze mode during idle.
	  The default is to enter Wait mode during idle. Doze mode during
	  idle will save additional power over Wait mode.

config ISP1504_MXC
	tristate "ISP1504 transceiver support"
	select ISP1504_MXC_OTG if USB_GADGET && USB_EHCI_HCD && USB_OTG
	help
	  Support for the ISP1504 USB transceiver on MXC platforms.

config ISP1504_MXC_OTG
	tristate
	help
	  Support for USB OTG using the ISP1504 transceiver on MXC platforms.

config ISP1301_MXC
	bool
	select I2C_MXC

config MXC_SDMA_API
        bool "Use SDMA API"
        default y
        help
           This selects the Freescale MXC SDMA API.
           If unsure, say N.

menu "Device options"

config I2C_MXC_SELECT1
	bool "Enable I2C1 module"
	default y
	depends on I2C_MXC
	help
	  Enable MX31 I2C1 module.

config I2C_MXC_SELECT2
	bool "Enable I2C2 module"
	default n
	depends on I2C_MXC
	help
	  Enable MX31 I2C2 module.

config I2C_MXC_SELECT3
	bool "Enable I2C3 module"
	default n
	depends on I2C_MXC
	help
	  Enable MX31 I2C3 module.

config FACTORY_ZONE
	bool "Enable Factory zone"
	default n
	depends on MACH_MX31HSV1
	help
	  This option enables the factory zone to be read and written to by the kernel.

config ATLAS_IMX_REGS
	bool "ATLAS, i.MX registers access"
	default y
	depends on MACH_MX31HSV1
	help
	  Enable the ATLAS MC13783 and i.MX31 registers to be read and written by the kernel.

config BATT_CH
	tristate "Enable battery charger"
	default y
	depends on MACH_MX31HSV1
	help
	  This driver is for battery charge monitoring and charger shutdown.

endmenu

endmenu
```

## pkgs/linux-2.6.19.2/arch/arm/plat-mxc/Kconfig
```kconfig
if ARCH_MXC

menu "Freescale MXC Implementations"

choice
	prompt "MXC/iMX System Type"
	default 0

config ARCH_MX3
	bool "MX31-based"
	help
	  This enables support for systems based on Freescale i.MX31

config MX31_TO2_REG_SWIZZLE_WORKAROUND
	bool "MX31-TO2 Register Swizzle Workaround"
	depends on ARCH_MX3
	help
	  This option attempts to work around a problem discovered with
	  MX31-TO2 silicon where a general register is loaded with an
	  address constant from a PC-relative location.  Upon going
	  indirect through this register, the address value contained
	  in the register will have been rotated right by 8 bits, causing
	  a memory fault.  The cause of the rotation is not known, nor is
	  the reason why this work around seems to make the problem go
	  away.  If you are using MX31-TO2 silicon and are faulting on
	  rotated addresses, enable this option.

config ARCH_MX27
	bool "MX27-based"
	select MXC_EMMA
	select GENERIC_TIME
	help
	  This enables support for systems based on Freescale i.MX27

endchoice

source "arch/arm/mach-mx27/Kconfig"

source "arch/arm/mach-mx3/Kconfig"

endmenu

config MXC_EMMA
	bool
	depends on ARCH_MXC

endif
```

## pkgs/linux-2.6.19.2/drivers/infrared/Kconfig
```kconfig
menu "Infrared Drivers"

config IRMOD
	depends on !SND_MXC_DECT
	bool "Infrared support (EXPERIMENTAL)"
	help
	  Infrared GPIO controler.

endmenu
```

## pkgs/linux-2.6.19.2/drivers/input/touchscreen/Kconfig
```kconfig
#
# Mouse driver configuration
#
menuconfig INPUT_TOUCHSCREEN
	bool "Touchscreens"
	help
	  Say Y here, and a list of supported touchscreens will be displayed.
	  This option doesn't affect the kernel.

	  If unsure, say Y.

if INPUT_TOUCHSCREEN

config TOUCHSCREEN_ADS7846
	tristate "ADS 7846 based touchscreens"
	depends on SPI_MASTER
	help
	  Say Y here if you have a touchscreen interface using the
	  ADS7846 controller, and your board-specific initialization
	  code includes that in its table of SPI devices.

	  If unsure, say N (but it's safe to say "Y").

	  To compile this driver as a module, choose M here: the
	  module will be called ads7846.

config TOUCHSCREEN_BITSY
	tristate "Compaq iPAQ H3600 (Bitsy) touchscreen"
	depends on SA1100_BITSY
	select SERIO
	help
	  Say Y here if you have the h3600 (Bitsy) touchscreen.

	  If unsure, say N.

	  To compile this driver as a module, choose M here: the
	  module will be called h3600_ts_input.

config TOUCHSCREEN_CORGI
	tristate "SharpSL (Corgi and Spitz series) touchscreen driver"
	depends on PXA_SHARPSL
	default y	
	help
	  Say Y here to enable the driver for the touchscreen on the 
	  Sharp SL-C7xx and SL-Cxx00 series of PDAs.

	  If unsure, say N.

	  To compile this driver as a module, choose M here: the
	  module will be called corgi_ts.

config TOUCHSCREEN_GUNZE
	tristate "Gunze AHL-51S touchscreen"
	select SERIO
	help
	  Say Y here if you have the Gunze AHL-51 touchscreen connected to
	  your system.

	  If unsure, say N.

	  To compile this driver as a module, choose M here: the
	  module will be called gunze.

config TOUCHSCREEN_ELO
	tristate "Elo serial touchscreens"
	select SERIO
	help
	  Say Y here if you have an Elo serial touchscreen connected to
	  your system.

	  If unsure, say N.

	  To compile this driver as a module, choose M here: the
	  module will be called elo.

config TOUCHSCREEN_MTOUCH
	tristate "MicroTouch serial touchscreens"
	select SERIO
	help
	  Say Y here if you have a MicroTouch (3M) serial touchscreen connected to
	  your system.

	  If unsure, say N.

	  To compile this driver as a module, choose M here: the
	  module will be called mtouch.

config TOUCHSCREEN_MK712
	tristate "ICS MicroClock MK712 touchscreen"
	help
	  Say Y here if you have the ICS MicroClock MK712 touchscreen
	  controller chip in your system.

	  If unsure, say N.

	  To compile this driver as a module, choose M here: the
	  module will be called mk712.

config TOUCHSCREEN_HP600
	tristate "HP Jornada 680/690 touchscreen"
	depends on SH_HP6XX && SH_ADC
	help
	  Say Y here if you have a HP Jornada 680 or 690 and want to
          support the built-in touchscreen.

	  If unsure, say N.

	  To compile this driver as a module, choose M here: the
	  module will be called hp680_ts_input.

config TOUCHSCREEN_PENMOUNT
	tristate "Penmount serial touchscreen"
	select SERIO
	help
	  Say Y here if you have a Penmount serial touchscreen connected to
	  your system.

	  If unsure, say N.

	  To compile this driver as a module, choose M here: the
	  module will be called penmount.

config TOUCHSCREEN_TOUCHRIGHT
	tristate "Touchright serial touchscreen"
	select SERIO
	help
	  Say Y here if you have a Touchright serial touchscreen connected to
	  your system.

	  If unsure, say N.

	  To compile this driver as a module, choose M here: the
	  module will be called touchright.

config TOUCHSCREEN_TOUCHWIN
	tristate "Touchwin serial touchscreen"
	select SERIO
	help
	  Say Y here if you have a Touchwin serial touchscreen connected to
	  your system.

	  If unsure, say N.

	  To compile this driver as a module, choose M here: the
	  module will be called touchwin.

config TOUCHSCREEN_MXC
	tristate "MXC touchscreen input driver"
	depends on MXC_MC13783_ADC
	help
	  Say Y here if you have an MXC based board with touchscreen
	  attached to it.

	  If unsure, say N.

	  To compile this driver as a module, choose M here: the
	  module will be called mxc_ts.

config TOUCHSCREEN_AD7877
	tristate "ADI 7877 touchscreen (LSV0)"
	depends on INPUT && INPUT_TOUCHSCREEN
	help
	  Say Y here if you have a ad7877 based board and want to
          support the built-in touchscreen in a kernel that does not have
          the new SPI driver model (pre-2.6.19)

	  If unsure, say N.

	  To compile this driver as a module, choose M here: the
	  module will be called ad7877_ts.
	  
config TOUCHSCREEN_AD7877_SPI
	tristate "ADI 7877 touchscreen (LSV0) new SPI driver"
	depends on INPUT && INPUT_TOUCHSCREEN && SPI_MASTER && ( ! TOUCHSCREEN_AD7877 )
	help
	  Say Y here if you have a ad7877 based board and want to
          support the built-in touchscreen on a kernel >= 2.6.19
          This is a driver adapted to the new SPI layer introduced in 2.6.19.
          The driver only uses the touchscreen interface and does not handle
          any other functions of the chip (DAC/ADC,Temperature sensor,Battery manager and GPIOs)

	  If unsure, say N.

	  To compile this driver as a module, choose M here: the
	  module will be called ad7877_spi.
	  
config TOUCHSCREEN_AD7877_DEBUG
	boolean "ADI 7877 touchscreen debug"
	depends on TOUCHSCREEN_AD7877 || TOUCHSCREEN_AD7877_SPI
	help
	  Say Y here if you want to enable debug printk

	  If unsure, say N.

endif
```

## pkgs/linux-2.6.19.2/drivers/media/video/mxc/output/Kconfig
```kconfig
config VIDEO_MXC_IPU_OUTPUT
	bool 
	depends on VIDEO_MXC_OUTPUT && MXC_IPU
	default y
	---help---
	  This is the video4linux2 driver for IPU post processing video output.

config VIDEO_MXC_OUTPUT_STATIC_BUFFERS
       bool "Pre-allocate buffers at startup"
       depends on VIDEO_MXC_OUTPUT
       default n

config VIDEO_MXC_OUTPUT_STATIC_BUFFERS_NUM
       int "Number of buffers to allocate"
       depends on VIDEO_MXC_OUTPUT_STATIC_BUFFERS
       default 10

config VIDEO_MXC_OUTPUT_STATIC_BUFFERS_SIZE
       int "Size of each buffer"
       depends on VIDEO_MXC_OUTPUT_STATIC_BUFFERS
       default 1048576

config VIDEO_MXC_EMMA_OUTPUT
	bool 
	depends on VIDEO_MXC_OUTPUT && MXC_EMMA && FB_MXC_SYNC_PANEL
	default y
	---help---
	  This is the video4linux2 driver for EMMA post processing video output.

config VIDEO_MXC_OUTPUT_FBSYNC
	bool "Synchronize the output with LCDC refresh"
	depends on VIDEO_MXC_EMMA_OUTPUT
	default y
	---help---
	  Synchronize the post-processing with LCDC EOF (End of Frame) to
	  prevent tearing issue. If unsure, say Y.
```

## pkgs/linux-2.6.19.2/drivers/mxc/Kconfig
```kconfig
# drivers/video/mxc/Kconfig

if ARCH_MXC

menu "MXC support drivers"

source "drivers/mxc/ipu/Kconfig"
source "drivers/mxc/ssi/Kconfig"
source "drivers/mxc/dam/Kconfig"
source "drivers/mxc/pmic/Kconfig"
source "drivers/mxc/pm/Kconfig"
source "drivers/mxc/security/Kconfig"
source "drivers/mxc/hmp4e/Kconfig"

if ARCH_MX27
source "drivers/mxc/vpu/Kconfig"
source "drivers/mxc/pwrmngt/Kconfig"
endif

if ARCH_MX3

menu "MXC MBX PowerVR OpenGL-ES"

config MXC_MBX
       bool "MBX Support"
       help
	Enable OpenGL-ES on broad.       

choice
       prompt "MBX size"
       depends on MXC_MBX
       default MXC_MBX_SIZE3

       config MXC_MBX_SIZE1
       	      bool "4 Mo"

       config MXC_MBX_SIZE2
       	      bool "8 Mo"

       config MXC_MBX_SIZE3
       	      bool "16 Mo"

       config MXC_MBX_SIZE4
       	      bool "32 Mo"

       config MXC_MBX_SIZE5
       	      bool "64 Mo"
endchoice

config MXC_MBX_SIZE
       int
       default 4 if MXC_MBX_SIZE1
       default 8 if MXC_MBX_SIZE2
       default 16 if MXC_MBX_SIZE3
       default 32 if MXC_MBX_SIZE4
       default 64 if MXC_MBX_SIZE5

endmenu

endif

endmenu

endif
```

## pkgs/linux-2.6.19.2/drivers/mxc/pm/Kconfig
```kconfig
#
# Power Managment devices
#

menu "Advanced Power Management devices"



endmenu
```

## pkgs/linux-2.6.19.2/drivers/mxc/pwrmngt/Kconfig
```kconfig
#
# Simple Power management
#

menu "Simple Power Management devices"

config MX27_PWRMNGT
	bool "Simple Power Management"
	depends on DPM && ARCH_MX27 && MXC_PMIC_MC13783
	help
	  Enable Simple Power Management, if implemented for your platform.
	  Simple Power Management is command by state (Normal,Doze,Stand By,
	  Deep Sleep, Power off). Each state call the platform implementation.
	  The implementation contains the basic drivers call corresponding to
	  the implementation. Depends on DPM in order use the dynamic change
	  CPU speed. 

	  If in doubt, say N.

endmenu
```

## pkgs/linux-2.6.19.2/drivers/usb/dect_sagem/Kconfig
```kconfig
#
# USB_DECT configuration
#
menu "DECT sagem"
	depends on USB

config USB_DECT
	tristate "DECT USB"
	depends on USB
	default y
	help
	   Driver dect
endmenu
```

## pkgs/linux-2.6.19.2/drivers/vbufpool/Kconfig
```kconfig
#Kernel Memory Driver

menu "Vbufpool Kernel Memory Driver"

config VBUFPOOL
	bool "Vbufpool driver"
	help
		Kernel memory large buffer allocation pool, say Y if you use large kernel buffers.
config VBUFPOOL_INIT_ALLOC
	depends on VBUFPOOL
	bool "Use initial allocated size"
	help
		If true, specify a initial allocation size on boot
		
config VBUFPOOL_INIT_ALLOC_SIZE
	int "Initial allocated size in kbyte (power of 2)"
	default 4096
	depends on VBUFPOOL_INIT_ALLOC

config VBUFPOOL_DYNAMIC
	bool "Vbufpool Dynamic"
	depends on VBUFPOOL
	help
		If this option is checked, the vbufpool driver will try to use normal memory 
		with dma_alloc_coherent() if no memory is allocated for the VBufpool. 
endmenu
```

## pkgs/linux-2.6.19.2/drivers/video/logo/Kconfig
```kconfig
#
# Logo configuration
#

menu "Logo configuration"

config LOGO
	bool "Bootup logo"
	depends on FB || SGI_NEWPORT_CONSOLE
	help
	  Enable and select frame buffer bootup logos.

config LOGO_LINUX_MONO
	bool "Standard black and white Linux logo"
	depends on LOGO
	default y

config LOGO_LINUX_VGA16
	bool "Standard 16-color Linux logo"
	depends on LOGO
	default y

config LOGO_LINUX_CLUT224
	bool "Standard 224-color Linux logo"
	depends on LOGO
	default y

choice
	depends on LOGO_LINUX_CLUT224
	prompt "Logo selection"
	default LOGO_DEFAULT_CLUT224

config LOGO_DEFAULT_CLUT224
	bool "Default 224 color logo"
	depends on LOGO

config LOGO_CUSTOM_CLUT224
	bool "Standard 224-color custom logo (Sagem customization)"
	depends on LOGO

endchoice

endmenu
```
