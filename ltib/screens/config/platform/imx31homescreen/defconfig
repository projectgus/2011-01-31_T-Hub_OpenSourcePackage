## pkgs/linux-2.6.19.2/drivers/video/progressbar/Kconfig
```kconfig
config PROGRESSBAR
	default n
	depends on ARCH_MXC
	bool "Progress bar"
   help
      Draw a progress bar over the logo screen.
      If unsure say No.

config PROGRESSBAR_DEBUG
	default n
	depends on PROGRESSBAR
	bool "Debug of Progress Bar"

choice 
   prompt "Choose the aspect of the progress bar." if PROGRESSBAR
   default PROGRESSBAR_ASPECT_FLAT
   depends on PROGRESSBAR

config PROGRESSBAR_ASPECT_FLAT
   bool "flat" 
   help 
      Flat aspect filled (left to right) by a single color.

config PROGRESSBAR_ASPECT_ROUNDED
   bool "rounded"
   help 
      Rounded predefined progressbar. No parmeter yet.

endchoice

config PROGRESSBAR_GEOMETRY
   string "Geometry"
   default "354x23+221+404" if PROGRESSBAR_ASPECT_ROUNDED
   default "347x4+289+329" if PROGRESSBAR_ASPECT_FLAT
   depends on PROGRESSBAR_ASPECT_FLAT
   help
      "WIDTHxHEIGHT+XTOP+YTOP"

config PROGRESSBAR_COLOR
   hex "Color of the progress bar in RGB888."
   default "0xC0C0C0"
   depends on PROGRESSBAR_ASPECT_FLAT
   help 
      The solid color of the progress bar.
```

## pkgs/linux-2.6.19.2/sound/arm/Kconfig
```kconfig
# ALSA ARM drivers

menu "ALSA ARM devices"
	depends on SND!=n && ARM

config SND_AUDIO_AMP
	tristate "Sagem audio amplifier"
	default y
	help
	  Say Y here if you want to control the gpio amplifer MX1500, 
	  TPA2012.
	  Driver can 
		  -	turn amplifier on or off
		  -	set the output gain.

config SND_SA11XX_UDA1341
	tristate "SA11xx UDA1341TS driver (iPaq H3600)"
	depends on ARCH_SA1100 && SND && L3
	select SND_PCM
	help
	  Say Y here if you have a Compaq iPaq H3x00 handheld computer
	  and want to use its Philips UDA 1341 audio chip.

	  To compile this driver as a module, choose M here: the module
	  will be called snd-sa11xx-uda1341.

config SND_ARMAACI
	tristate "ARM PrimeCell PL041 AC Link support"
	depends on SND && ARM_AMBA
	select SND_PCM
	select SND_AC97_CODEC

config SND_PXA2XX_PCM
	tristate
	select SND_PCM

config SND_PXA2XX_AC97
	tristate "AC97 driver for the Intel PXA2xx chip"
	depends on ARCH_PXA && SND
	select SND_PXA2XX_PCM
	select SND_AC97_CODEC
	help
	  Say Y or M if you want to support any AC97 codec attached to
	  the PXA2xx AC97 interface.

config SND_MXC_PMIC
	tristate "MXC PMIC sound system"
	depends on ARCH_MXC && MXC_DAM && MXC_SSI && MXC_MC13783_AUDIO
	default y
	select SND_PCM
	help
	  Say Y here to include support for soundcards based on the
	  MC13783 chip.

	  To compile this driver as a module, choose M here: the module
	  will be called snd-mc13783.

config SND_MXC_PMIC_USE_CONV_TABLE
	bool "Compute gain using conversion table"
	depends on SND_MXC_PMIC
	default n
	help
	  Say Y here if you want to compute output gain 
	  using a conversion table : conversion is not 
	  linear and is different if headset is plugged.
	  Say N if you want output gain to be a percentage 
	  based on alsa volume. Headset volume max is 
	  limited by output volume max.
	  

choice	
   	prompt "MXC DECT interface"
	default SND_MXC_DECT_USB
	help
	  Say Y here to activate DECT interface.

config SND_MXC_DECT
	tristate "MXC DECT OEM sound system"
	select SND_PCM
	depends on MXC_DAM && MXC_SSI
	help
	  Say Y here to include support for soundcards based on the
	  Dect chip using OEM interface.

config SND_MXC_DECT_USB
	tristate "MXC DECT USB sound system"
	select SND_PCM
	depends on USB_DECT
	help
	  Say Y here to include support for soundcards based on the
	  Dect chip using USB interface.
endchoice

endmenu
source "sound/arm/bridge/Kconfig"
```

## pkgs/linux-2.6.19.2/sound/arm/bridge/Kconfig
```kconfig
#
# AUDIO_BRIDGE configuration
#

choice
	prompt "Audio bridge selection"
	depends on USB
	default DECTUSB_TO_PMIC

config SND_AUDIO_BRIDGE
	tristate "Dectusb to pmic"
	depends on USB
        help
	  Bridge between dect USB driver and pmic.



endchoice


config DELAY_COMPENSATION
       bool "Enable delay compensation"
       depends on SND_AUDIO_BRIDGE
       default y
       help 
       	   Enable delay monitoring and compensation in audio
	   the audio bridge 


config AUDIO_BRIDGE_CONSOLE_TRACES
	bool "Enable Stream Recording in Audio Bridge"
	depends on SND_AUDIO_BRIDGE
	default y
        help
	   Enable Stream recording on playback and/or capture 
	   buffer ports



config RELAY_TO_DEBUGFS
	bool "Enable Stream Recording in Audio Bridge"
	depends on SND_AUDIO_BRIDGE
	default n
        help
	   Enable Stream recording on playback and/or capture 
	   buffer ports


config RELAY_DECT_CAPTURE
       bool "Capute samples recieved from DECT"
       depends on RELAY_TO_DEBUGFS
       default y
       help
	    This will activate the capture of samples posted
	    by the DECT driver
       
config RELAY_DECT_PLAYBACK
       bool "Capute samples sent to DECT"
       depends on RELAY_TO_DEBUGFS
       default y
       help
	    This will activate the capture of samples posted
	    by the PMIC driver


config RELAY_PMIC_CAPTURE
       bool "Capute samples received from PMIC"
       depends on RELAY_TO_DEBUGFS
       default y
       help
	    This will activate the capture of samples posted
	    by the DECT driver


config RELAY_PMIC_PLAYBACK
       bool "Capute samples sent to PMIC"
       depends on RELAY_TO_DEBUGFS
       default y
       help
	    This will activate the capture of samples posted
	    by the DECT driver



config DUMP_SIN_BRIDGE
	bool "Override capture stream with a sinus wave form"
	depends on SND_AUDIO_BRIDGE
	default n
        help
	  Override capture stream with a sinus wave form

config DUMP_SIN_FROM_DECT
       bool "Prove to the bridge a sin wave instead of DECT data"
       depends on DUMP_SIN_BRIDGE
       default y
       help
	   Replace data provided by the DECT to the audio bridge
	   by a sin wave

config DUMP_SIN_FROM_PMIC
       bool "Prove to the bridge a sin wave instead of PMIC data"
       depends on DUMP_SIN_BRIDGE
       default y
       help
	   Replace data provided by the DECT to the audio bridge
	   by a sin wave
```
